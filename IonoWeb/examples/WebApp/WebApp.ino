/*
  WebApp.ino - Arduino sketch implementing a Web application to control, monitor and configure iono

    Copyright (C) 2014-2017 Sfera Labs S.r.l. - All rights reserved.

    For information, see:
    http://www.sferalabs.cc/iono-arduino
  
  This code is free software; you can redistribute it and/or
  modify it under the terms of the GNU Lesser General Public
  License as published by the Free Software Foundation; either
  version 2.1 of the License, or (at your option) any later version.
  See file LICENSE.txt for further informations on licensing terms.
*/

#include <SPI.h>
#include <EEPROM.h>
#ifdef ARDUINO_AVR_LEONARDO_ETH
  #include <Ethernet2.h>
#else
  #include <Ethernet.h>
#endif
#include <Iono.h>
#include <WebServer.h>
#include <IonoWeb.h>

byte mac[6];
byte ip[4];
byte dnsa[4];
byte gateway[4];
byte subnet[4];

char pwd[9];

void configCmd(WebServer &webServer, WebServer::ConnectionType type, char* urlTail, bool tailComplete) {

  webServer.httpSuccess();
  webServer.print("{");
  
  webServer.print("\"i\":\"");
  for (int i = 0; i < 4; i++) {
    if (i != 0) {
      webServer.print(".");
    }
    webServer.print(ip[i]);
  }
  
  webServer.print("\",\"d\":\"");
  for (int i = 0; i < 4; i++) {
    if (i != 0) {
      webServer.print(".");
    }
    webServer.print(dnsa[i]);
  }
  
  webServer.print("\",\"g\":\"");
  for (int i = 0; i < 4; i++) {
    if (i != 0) {
      webServer.print(".");
    }
    webServer.print(gateway[i]);
  }
  
  webServer.print("\",\"s\":\"");
  for (int i = 0; i < 4; i++) {
    if (i != 0) {
      webServer.print(".");
    }
    webServer.print(subnet[i]);
  }
  
  webServer.print("\",\"m\":\"");
  for (int i = 0; i < 6; i++) {
    if (i != 0) {
      webServer.print(":");
    }      
    char hex[3];
    hex[0] = (mac[i] >> 4) + 0x30;
    if (hex[0] > 0x39) hex[0] +=7;
    hex[1] = (mac[i] & 0x0f) + 0x30;
    if (hex[1] > 0x39) hex[1] +=7;
    hex[2] = '\0';
    webServer.print(hex);
  }

  webServer.print("\",\"p\":\"");
  webServer.print(pwd);

  webServer.print("\"}");
}

void webPageCmd(WebServer &webServer, WebServer::ConnectionType type, char* urlTail, bool tailComplete) {
  if (strlen(urlTail) == 0) { // serve page
    webServer.httpSuccess("text/html", "Content-Encoding: gzip\r\n");

    // These are the bytes of the zipped web page.
    // HOW-TO:
    // minify iono.html (e.g. use https://kangax.github.io/html-minifier/)
    // gzip -n -k -9 iono-min.html
    // hexdump -ve '1/1 "0x%.2x,"' iono-min.html.gz > bytes.txt
    P(page) = {0x1f,0x8b,0x08,0x00,0x00,0x00,0x00,0x00,0x02,0x03,0x95,0x58,0x7f,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0x00,0x00};
    webServer.writeP(page, sizeof(page));

  } else {
    if (tailComplete) {
      char name[8];
      char value[30];
      URLPARAM_RESULT rc;
  
      while (strlen(urlTail)) {
        rc = webServer.nextURLparam(&urlTail, name, 8, value, 30);
        if (rc == URLPARAM_EOS) {
          webServer.httpFail();
          return;
        }
  
        if (strcmp(name, "i") == 0) {
          setField(ip, value, '.', 10);
        } else if (strcmp(name, "d") == 0) {
          setField(dnsa, value, '.', 10);
        } else if (strcmp(name, "g") == 0) {
          setField(gateway, value, '.', 10);
        } else if (strcmp(name, "s") == 0) {
          setField(subnet, value, '.', 10);
        } else if (strcmp(name, "m") == 0) {
          setField(mac, value, ':', 16);
        } else if (strcmp(name, "p") == 0) {
          for (int i = 0; i < 9; i++) {
            pwd[i] = '\0';
          }
          strncpy(pwd, value, 8);
        }
      }
      
      byte checksum = 7;
      int a = 0;
      for (; a < 4; a++) {
        EEPROM.write(a, ip[a]);
        checksum ^= ip[a];
      }
      for (; a < 8; a++) {
        EEPROM.write(a, dnsa[a - 4]);
        checksum ^= dnsa[a - 4];
      }
      for (; a < 12; a++) {
        EEPROM.write(a, gateway[a - 8]);
        checksum ^= gateway[a - 8];
      }
      for (; a < 16; a++) {
        EEPROM.write(a, subnet[a - 12]);
        checksum ^= subnet[a - 12];
      }
      for (; a < 22; a++) {
        EEPROM.write(a, mac[a - 16]);
        checksum ^= mac[a - 16];
      }
      for (; a < 38; a+=2) {
        char c = pwd[(a - 22) / 2];
        byte l = c & 0xff;
        byte h = (c >> 8) & 0xff;
        EEPROM.write(a, l);
        EEPROM.write(a + 1, h);
        checksum ^= l;
        checksum ^= h;
      }
      EEPROM.write(a, checksum);
      
      webServer.httpSuccess();
      webServer.flushBuf();
      webServer.reset();
      
      delay(500);
      
      Ethernet.begin(mac, ip, dnsa, gateway, subnet);
      
    } else {
      webServer.httpFail();
    }
  }
}

void setField(byte *ip, char *value, char sep, int base) {
  int p = 0;
  int g = 0;
  for (int c = 0; c < 30; c++) {
    if (value[c] == sep || value[c] == '\0') {
      char n[4];
      int i = p;
      for (; i < c; i++) {
        n[i - p] = value[i];
      }
      n[i - p] = '\0';
      ip[g] = strtoul(n, NULL, base);
      if (value[c] == '\0') {
        break;
      }
      p = c + 1;
      g++;
    }
  }
}

void setup() {
  Iono.setup();
  pinMode(2, INPUT);
  pinMode(3, OUTPUT);
  boolean reset = true;
  for (int i = 0; i < 5; i++) {
    digitalWrite(3, i % 2);
    if (digitalRead(2) != i % 2) {
      reset = false;
    }
  }
  pinMode(3, INPUT);

  if (!reset) {
    byte checksum = 7;
    int a = 0;
    for (; a < 4; a++) {
      ip[a] = EEPROM.read(a);
      checksum ^= ip[a];
    }
    for (; a < 8; a++) {
      dnsa[a - 4] = EEPROM.read(a);
      checksum ^= dnsa[a - 4];
    }
    for (; a < 12; a++) {
      gateway[a - 8] = EEPROM.read(a);
      checksum ^= gateway[a - 8];
    }
    for (; a < 16; a++) {
      subnet[a - 12] = EEPROM.read(a);
      checksum ^= subnet[a - 12];
    }
    for (; a < 22; a++) {
      mac[a - 16] = EEPROM.read(a);
      checksum ^= mac[a - 16];
    }
    for (; a < 38; a+=2) {
      byte l = EEPROM.read(a);
      byte h = EEPROM.read(a + 1);
      pwd[(a - 22) / 2] = (h << 8) + l;
      checksum ^= l;
      checksum ^= h;
    }
    
    if (EEPROM.read(a) != checksum) {
      reset = true;
    }
  }

  if (reset) {
    ip[0] = 192;
    ip[1] = 168;
    ip[2] = 0;
    ip[3] = 100;

    dnsa[0] = 192;
    dnsa[1] = 168;
    dnsa[2] = 0;
    dnsa[3] = 1;
    
    gateway[0] = 192;
    gateway[1] = 168;
    gateway[2] = 0;
    gateway[3] = 1;
    
    subnet[0] = 255;
    subnet[1] = 255;
    subnet[2] = 255;
    subnet[3] = 0;
    
    mac[0] = 0xDE;
    mac[1] = 0xAD;
    mac[2] = 0xBE;
    mac[3] = 0xEF;
    mac[4] = 0xFE;
    mac[5] = 0xED;

    pwd[0] = '\0';
  }

  Ethernet.begin(mac, ip, dnsa, gateway, subnet);
  
  IonoWeb.begin(80);
  WebServer &webServer = IonoWeb.getWebServer();
  webServer.setDefaultCommand(&webPageCmd);
  webServer.addCommand("config", &configCmd);
}

void loop() {
  // Process incoming requests
  IonoWeb.processRequest();
  // Check all the inputs - needed for subscribe
  Iono.process();
}
